## src/Kconfig.projbuild
```kconfig
# Copyright 2021,2022,2023 David SPORN
# ---
# This file is part of 'Weather Central'.
# ---
# 'Weather Central' is free software: you can redistribute it and/or 
# modify it under the terms of the GNU General Public License as published 
# by the Free Software Foundation, either version 3 of the License, or 
# (at your option) any later version.

# 'Weather Central' is distributed in the hope that it will be useful, 
# but WITHOUT ANY WARRANTY; without even the implied warranty of 
# MERCHANTABILITY or FITNESS FOR A PARTICULAR PURPOSE. See the GNU General 
# Public License for more details.

# You should have received a copy of the GNU General Public License along 
# with 'Weather Central'. If not, see <https://www.gnu.org/licenses/>. 

menu "The Clock by Sporniket"

	config LABEL_TITLE
		string "Project title"
		default "The Clock by Sporniket"
		help
			Use this label when you want to show an unlocalized title.

	config SNTP_TIME_SERVER
		string "SNTP server name"
		default "pool.ntp.org"
		help
			Hostname of the main SNTP server.

	rsource "Kconfig-control-panel-mapping.projbuild"

	rsource "Kconfig-iic-controller-1.projbuild"

endmenu #"WEATHER CENTRAL"
```
